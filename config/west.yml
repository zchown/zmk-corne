## config/west.yml
```yaml
manifest:
  remotes:
    - name: zmkfirmware
      url-base: https://github.com/zmkfirmware
    - name: MrBanh
      url-base: https://github.com/MrBanh
  projects:
    - name: zmk
      remote: zmkfirmware
      revision: main
      import: app/west.yml
    - name: nice-view-bongo-cat
      remote: MrBanh
      revision: main
  self:
    path: config
```
